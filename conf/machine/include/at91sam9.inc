## conf/machine/include/at91sam9.inc
```bitbake
# Atmel AT91SAM9 defaults
require conf/machine/include/soc-family.inc
require conf/machine/include/tune-arm926ejs.inc
require conf/machine/include/bootloaders.inc

SOC_FAMILY = "at91sam9"

PREFERRED_PROVIDER_virtual/kernel_at91sam9 ?= "linux-at91"
PREFERRED_PROVIDER_virtual/bootloader_at91sam9 ?= "u-boot-at91"

DTB_LOAD ?= "0x21000000"
DTBO_LOAD ?= "0x20f00000"

# used by sysvinit_2
SERIAL_CONSOLE ?= "115200 ttyS0"
```

## conf/machine/include/sama5.inc
```bitbake
# Atmel SAMA5 defaults
require conf/machine/include/soc-family.inc
require conf/machine/include/tune-cortexa5.inc
require conf/machine/include/bootloaders.inc

SOC_FAMILY = "sama5"

PREFERRED_PROVIDER_virtual/kernel_sama5 ?= "linux-at91"
KERNEL_IMAGETYPES += "fitImage"
# Required by kernel-fitimage class
PREFERRED_PROVIDER_u-boot_sama5 ?= "u-boot-at91"
PREFERRED_PROVIDER_virtual/bootloader_sama5 ?= "u-boot-at91"

PREFERRED_PROVIDER_jpeg ?= "jpeg"
PREFERRED_PROVIDER_jpeg-native ?= "jpeg-native"

DTB_LOAD ?= "0x21000000"
DTBO_LOAD ?= "0x20f00000"

# used by sysvinit_2
SERIAL_CONSOLE ?= "115200 ttyS0"
```

## conf/machine/sama5d2-xplained-sd.conf
```bitbake
#@TYPE: Machine
#@Name: ATMEL SAMA5D2 Xplained SD
#@DESCRIPTION: Machine configuration for Atmel's evaluation board

require include/sama5d2.inc

MACHINEOVERRIDES =. "at91-sd:"

MACHINE_FEATURES = "kernel26 apm alsa ext2 ext3 usbhost usbgadget screen camera can touchscreen ppp"
KERNEL_DEVICETREE = "at91-sama5d2_xplained.dtb"
KERNEL_DEVICETREE_OVERLAYS = "at91-sama5d2_xplained_pda4.dtbo at91-sama5d2_xplained_pda7.dtbo at91-sama5d2_xplained_pda7b.dtbo at91-sama5d2_xplained_ov7670.dtbo at91-sama5d2_xplained_ov7740.dtbo"

IMAGE_FSTYPES += " tar.gz wic"

do_image_wic[depends] += "u-boot-at91:do_deploy"
WKS_FILE = "sdimage-bootpart.wks"
IMAGE_BOOT_FILES = "BOOT.BIN u-boot.bin fitImage"

UBOOT_MACHINE ?= "sama5d2_xplained_mmc_defconfig"
UBOOT_ENTRYPOINT = "0x20008000"
UBOOT_LOADADDRESS = "0x20008000"

AT91BOOTSTRAP_MACHINE ?= "sama5d2_xplained"

# Needed for wic
EXTRA_IMAGEDEPENDS += "dosfstools-native mtools-native"
```

## conf/machine/sama5d27-som1-ek-sd.conf
```bitbake
#@TYPE: Machine
#@Name: ATMEL SAMA5D2 SOM1 EK SD
#@DESCRIPTION: Machine configuration for Atmel/Microchip's evaluation board

require include/sama5d2.inc

MACHINEOVERRIDES =. "at91-sd:"

MACHINE_FEATURES = "kernel26 apm alsa ext2 ext3 usbhost usbgadget screen can touchscreen ppp"
KERNEL_DEVICETREE = "at91-sama5d27_som1_ek.dtb \
		"
KERNEL_DEVICETREE_OVERLAYS = "at91-sama5d27_som1_ek_pda4.dtbo at91-sama5d27_som1_ek_pda7.dtbo at91-sama5d27_som1_ek_pda7b.dtbo"

do_image_wic[depends] += "u-boot-at91:do_deploy"
IMAGE_FSTYPES += " tar.gz wic"
WKS_FILE = "sdimage-bootpart.wks"
IMAGE_BOOT_FILES = "BOOT.BIN u-boot.bin zImage \
	zImage-at91-sama5d27_som1_ek.dtb;at91-sama5d27_som1_ek.dtb \
	at91-sama5d27_som1_ek_pda4.dtbo \
	at91-sama5d27_som1_ek_pda7b.dtbo \
	at91-sama5d27_som1_ek_pda7.dtbo \
	"

UBOOT_MACHINE ?= "sama5d27_som1_ek_mmc_defconfig"
UBOOT_ENTRYPOINT = "0x20008000"
UBOOT_LOADADDRESS = "0x20008000"

AT91BOOTSTRAP_MACHINE ?= "sama5d27_som1_ek"

# Needed for wic
EXTRA_IMAGEDEPENDS += "dosfstools-native mtools-native"
```

## conf/machine/sama5d4-xplained-sd.conf
```bitbake
#@TYPE: Machine
#@Name: ATMEL SAMA5D4 Xplained Ultra
#@DESCRIPTION: Machine configuration for Atmel's evaluation board

require include/sama5d4.inc

MACHINEOVERRIDES =. "at91-sd:"

MACHINE_FEATURES = "kernel26 apm alsa ext2 ext3 usbhost usbgadget screen camera can touchscreen ppp"
KERNEL_DEVICETREE = "at91-sama5d4_xplained.dtb"
KERNEL_DEVICETREE_OVERLAYS = "at91-sama5d4_xplained_pda4.dtbo at91-sama5d4_xplained_pda7.dtbo at91-sama5d4_xplained_pda7b.dtbo at91-sama5d4_xplained_hdmi.dtbo"

IMAGE_FSTYPES += " tar.gz wic"

do_image_wic[depends] += "u-boot-at91:do_deploy"
WKS_FILE = "sdimage-bootpart.wks"
IMAGE_BOOT_FILES = "BOOT.BIN u-boot.bin fitImage"

UBOOT_MACHINE ?= "sama5d4_xplained_mmc_defconfig"
UBOOT_ENTRYPOINT = "0x20008000"
UBOOT_LOADADDRESS = "0x20008000"

AT91BOOTSTRAP_MACHINE ?= "sama5d4_xplained"

# Needed for wic
EXTRA_IMAGEDEPENDS += "dosfstools-native mtools-native"
```
